/*

   This is the code for IOT DisplayV2 made by team techiesms

   This code will help you to display multiple things on Multiple p4 displays


*/


#include "ESP32-HUB75-MatrixPanel-I2S-DMA.h"
#include <ArduinoJson.h>
#include <HTTPClient.h>


#include "WiFi.h"
#include <ESPmDNS.h>

#include <HTTPClient.h>
#include <WiFiClientSecure.h>

#include "JsonStreamingParser.h"  //https://github.com/squix78/json-streaming-parser
#include <YoutubeApi.h>  //https://github.com/witnessmenow/arduino-youtube-api

#include <AsyncTCP.h>
#include <ESPAsyncWebServer.h>


const char* pop = "abcd1234";           // Proof of possession - otherwise called a PIN - string provided by the device, entered by user in the phone app
const char* service_name = "PROV_123";  // Name of your device (the Espressif apps expects by default device name starting with "Prov_")
const char* service_key = NULL;         // Password used for SofAP method (NULL = no password needed)
bool reset_provisioned = false;         // When true the library will automatically delete previously provisioned data.
bool is_connected = 0;


AsyncWebServer server(80);

const char* PARAM_INPUT_1 = "input1";
const char* PARAM_INPUT_2 = "color";
const char* PARAM_INPUT_3 = "insta";
const char* color;
const char* insta;


//******************************************************************************************* HTML WEB PAGE

// HTML web page to handle 3 input fields (Custom Text, Its Color, Instagram Follower)
const char index_html[] PROGMEM = R"rawliteral(
<!DOCTYPE HTML><html><head>
  <title>ESP Input Form</title>
  <meta name="viewport" content="width=device-width, initial-scale=1">
  </head><body>
  <form action="/get">
   <label for="input1">Input text:</label><br>
  <input type="text" id="input1" name="input1" value=""><br>
    <label for="color">Choose a Color:</label>
    <input type="color" id="color" name="color"><br><br>
   <label for="insta">Instagram Followers:</label><br>
  <input type="text" id="insta" name="insta" value=""><br><br>
   <input type="submit" value="Submit">
  </form>
</body></html>)rawliteral";

void notFound(AsyncWebServerRequest* request) {
  request->send(404, "text/plain", "Not found");
}

//************************************************************ Credentials For YouTube
#define API_KEY "YOUR API KEY"
#define CHANNEL_ID "UC7raRsx4ojx3cyXT3x9-PuQ"

WiFiClientSecure secureClient;
WiFiClientSecure client;
YoutubeApi api(API_KEY, client);


//************************************************************ For Current Date & Time
const char* Hostname = "worldtimeapi.org";
String URI = "/api/timezone/asia/kolkata";
const uint16_t port = 80;


//************************************************************ Variables
int i;
int y;
int r, g, b;

long subs = 0;
unsigned long nextRunTime;
unsigned long timeBetweenRequests = 60000;

String DATE;
String Day;
String Date;
String Status;
String Time;
String Day_str = "";
String day_of_week;

String customdata = " ";
String inputParam;
String colordata = " ";
String inputParam2;
String inputMessage3 = " ";
String inputParam3;
String instaMessage;

bool instaconnect = 0;
bool inputvalue = 0;
bool ampm = 0;



//************************************************************ Display Config Declaration
#define double_buffer


#define PANEL_RES_X 64  // Number of pixels wide of each INDIVIDUAL panel module.
#define PANEL_RES_Y 32  // Number of pixels tall of each INDIVIDUAL panel module.
#define PANEL_CHAIN 5   // Total number of panels chained one to another


//MatrixPanel_I2S_DMA dma_display;
MatrixPanel_I2S_DMA* dma_display = nullptr;

uint16_t myBLACK = dma_display->color565(0, 0, 0);
uint16_t myWHITE = dma_display->color565(255, 255, 255);
uint16_t myRED = dma_display->color565(255, 0, 0);
uint16_t myGREEN = dma_display->color565(0, 255, 0);
uint16_t myBLUE = dma_display->color565(0, 0, 255);
uint16_t myTECHIESMS = dma_display->color565(25, 189, 255);

// Input a value 0 to 255 to get a color value.
// The colours are a transition r - g - b - back to r.



//************************************************************ For WiFi Provisioning
void SysProvEvent(arduino_event_t* sys_event) {
  switch (sys_event->event_id) {
    case ARDUINO_EVENT_WIFI_STA_GOT_IP:
      dma_display->clearScreen();
      dma_display->setTextSize(4);
      dma_display->setCursor(0, 2);
      dma_display->setTextColor(myTECHIESMS);
      dma_display->print("Connected");
      Serial.print("\nConnected IP address : ");
      Serial.println(IPAddress(sys_event->event_info.got_ip.ip_info.ip.addr));


      //************************************************************ Started running MDNS so that we don't need
      if (!MDNS.begin("iotdisplay")) {
        Serial.println("Error setting up MDNS responder!");
        while (1) {
          delay(1000);
        }
      }
      Serial.println("mDNS responder started");
      is_connected = 1;
      break;
    case ARDUINO_EVENT_WIFI_STA_DISCONNECTED:
      Serial.println("\nDisconnected. Connecting to the AP again... ");
      Credential_Reset();
      break;
    case ARDUINO_EVENT_PROV_START:
      Serial.println("\nProvisioning started\nGive Credentials of your access point using smartphone app");
      break;
    case ARDUINO_EVENT_PROV_CRED_RECV:
      {
        Serial.println("\nReceived Wi-Fi credentials");
        Serial.print("\tSSID : ");
        Serial.println((const char*)sys_event->event_info.prov_cred_recv.ssid);
        Serial.print("\tPassword : ");
        Serial.println((char const*)sys_event->event_info.prov_cred_recv.password);
        break;
      }
    case ARDUINO_EVENT_PROV_CRED_FAIL:
      {
        Serial.println("\nProvisioning failed!\nPlease reset to factory and retry provisioning\n");
        if (sys_event->event_info.prov_fail_reason == WIFI_PROV_STA_AUTH_ERROR)
          Serial.println("\nWi-Fi AP password incorrect");
        else
          Serial.println("\nWi-Fi AP not found....Add API \" nvs_flash_erase() \" before beginProvision()");
        break;
      }
    case ARDUINO_EVENT_PROV_CRED_SUCCESS:
      Serial.println("\nProvisioning Successful");
      dma_display->clearScreen();
      dma_display->setTextSize(4);
      dma_display->setCursor(0, 2);
      dma_display->setTextColor(myTECHIESMS);
      dma_display->print("Wifi Successful");
      delay(2000);
      break;
    case ARDUINO_EVENT_PROV_END:
      Serial.println("\nProvisioning Ends");
      ESP.restart();
      is_connected = 1;
      break;
    default:
      break;
  }
}
//******************************************************************************************************************************* Instagram LOGO
uint16_t static Insta_logo[] = {
  0x0000, 0x0000, 0x0000, 0x0000, 0x0000, 0x0000, 0x0000, 0x0000, 0x0000, 0x0000, 0x0000, 0x0000, 0x0000, 0x0000, 0x0000, 0x0000,  // 0x0010 (16) pixels
  0x0000, 0x0000, 0x0000, 0x0000, 0x0000, 0x0000, 0x0000, 0x0000, 0x0000, 0x0000, 0x0000, 0x0000, 0x0000, 0x0000, 0x0000, 0x0000,  // 0x0020 (32) pixels
  0x0000, 0x0000, 0x0000, 0x0000, 0x0000, 0x0820, 0x2967, 0x31EB, 0x424D, 0x3A2D, 0x3A2D, 0x3A2D, 0x3A2D, 0x3A2D, 0x3A2D, 0x422D,  // 0x0030 (48) pixels
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  0x0000, 0x0000, 0x0000, 0x0000, 0x0000, 0x0000, 0x0000, 0x0000, 0x0000, 0x0000, 0x0000, 0x0000, 0x0000, 0x0000, 0x0000, 0x0000,  // 0x0400 (1024) pixels
};

void drawInsta(int x, int y) {
  int counter = 0;
  for (int yy = 0; yy < 32; yy++) {
    for (int xx = 0; xx < 32; xx++) {
      dma_display->drawPixel(xx + x, yy + y, Insta_logo[counter]);
      counter++;
    }
  }
}
//******************************************************************************************************************************************************** YouTube Logo
uint16_t static Youtube[] = {
  0x0000, 0x0000, 0x0000, 0x0000, 0x0000, 0x0000, 0x0000, 0x0000, 0x0000, 0x0000, 0x0000, 0x0000, 0x0000, 0x0000, 0x0000, 0x0000,  // 0x0010 (16) pixels
  0x0000, 0x0000, 0x0000, 0x0000, 0x0000, 0x0000, 0x0000, 0x0000, 0x0000, 0x0000, 0x0000, 0x0000, 0x0000, 0x0000, 0x0000, 0x0000,  // 0x0020 (32) pixels
  0x0000, 0x0000, 0x0000, 0x0000, 0x0000, 0x0000, 0x0000, 0x0000, 0x0000, 0x0000, 0x0000, 0x0000, 0x0000, 0x0000, 0x0000, 0x0000,  // 0x0030 (48) pixels
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  0x0000, 0x0000, 0x0000, 0x0000, 0x0000, 0x0000, 0x0000, 0x0000, 0x0000, 0x0000, 0x0000, 0x0000, 0x0000, 0x0000, 0x0000, 0x0000,  // 0x10C0 (4288) pixels
};


void drawLoGo(int x, int y) {
  int counter = 0;
  for (int yy = 0; yy < 32; yy++) {
    for (int xx = 0; xx < 134; xx++) {
      dma_display->drawPixel(xx + x, yy + y, Youtube[counter]);
      counter++;
    }
  }
}



//**********************************************************************************************************************************************************
void setup() {


  Serial.begin(115200);

  Serial.println();
  Serial.println();
  Serial.print("Connecting to WiFi");


  // ENTER YOUR WIFI CREDENTIALS
  WiFi.begin("SSID", "PASS");

  while (WiFi.status() != WL_CONNECTED) {
    delay(500);
    Serial.print(".");
  }

  Serial.println("");
  Serial.println("WiFi connected.");
  Serial.println("IP address: ");
  Serial.println(WiFi.localIP());

  //************************************************************ Started running MDNS so that we don't need
  if (!MDNS.begin("iotdisplay")) {
    Serial.println("Error setting up MDNS responder!");
    while (1) {
      delay(1000);
    }
  }
  Serial.println("mDNS responder started");
  is_connected = 1;
  pinMode(0, INPUT);



  // Configurations for Display
  HUB75_I2S_CFG mxconfig(
    PANEL_RES_X,  // module width
    PANEL_RES_Y,  // module height
    PANEL_CHAIN   // Chain length
  );

  mxconfig.gpio.e = 32;
  mxconfig.clkphase = false;
  mxconfig.driver = HUB75_I2S_CFG::FM6124;

  // Display Setup
  dma_display = new MatrixPanel_I2S_DMA(mxconfig);
  dma_display->begin();
  dma_display->setBrightness8(255);  //0-255
  dma_display->clearScreen();



  // Setting up HTML page for Custom Message Input
  WiFi.mode(WIFI_STA);
  client.setInsecure();


  // Send web page with input fields to client
  server.on("/", HTTP_GET, [](AsyncWebServerRequest * request) {
    request->send_P(200, "text/html", index_html);
  });

  // Send a GET request to <ESP_IP>/get?input1=<inputMessage>
  server.on("/get", HTTP_GET, [](AsyncWebServerRequest * request) {
    customdata;
    colordata;
    String inputParam;
    String inputParam2;
    instaMessage;
    String inputParam3;


    // GET input1 value on <ESP_IP>/get?input1=<inputMessage>
    if (request->hasParam(PARAM_INPUT_1)) {
      customdata = request->getParam(PARAM_INPUT_1)->value();
      inputParam = PARAM_INPUT_1;

      if (customdata.length() > 0) {
        inputvalue = 1;
        Serial.print("customdata length = ");
        Serial.println(customdata.length());
      }

      Serial.print("customdata = ");
      Serial.println(customdata);
    }

    // GET color value on <ESP_IP>/get?color=<inputMessage>
    if (request->hasParam(PARAM_INPUT_2)) {
      colordata = request->getParam(PARAM_INPUT_2)->value();
      inputParam2 = PARAM_INPUT_2;
      Serial.print("colordata =");
      Serial.println(colordata);
      //************** HEX TO RGB  ***********************************
      String hexstring = colordata;
      int number = (int)strtol(&hexstring[1], NULL, 16);
      r = number >> 16;
      g = number >> 8 & 0xFF;
      b = number & 0xFF;

      Serial.print("red is ");
      Serial.println(r);
      Serial.print("green is ");
      Serial.println(g);
      Serial.print("blue is ");
      Serial.println(b);
    }

    // GET color value on <ESP_IP>/get?insta=<inputMessage3>
    if (request->hasParam(PARAM_INPUT_3)) {
      instaMessage = request->getParam(PARAM_INPUT_3)->value();
      inputParam3 = PARAM_INPUT_3;
      Serial.print("inputMessage3 = ");
      Serial.println(instaMessage.length());
      if (instaMessage.length() == 0) {
        instaMessage = inputMessage3;
        Serial.println("Msg Not updated");
      } else {
        instaconnect = 1;
        // instaMessage = inputMessage3;
        inputMessage3 = instaMessage;
        Serial.println("Msg Updated");
      }
      Serial.print("Insatgram = ");
      Serial.println(instaMessage);
    }
    //**********************************************************************************************
    request->send(200, "text/html", "HTTP GET request sent to your ESP on input field (" + inputParam + ")  with value: " + customdata + "<br> HTTP GET request sent to your ESP on input field (" + inputParam2 + ")  with value: " + colordata + "<br>HTTP GET request sent to your ESP on input field (" + inputParam3 + ")  with value: " + instaMessage + "<br><br><a href=\"/\">Return to Home Page</a>");
  });

  server.onNotFound(notFound);
  server.begin();
}


//******************************************************************** Function For Displaying Instagram Followers and Logo
void Instagram() {
  for (int i = 300; i > 50; i--) {
    drawInsta(i, 0);
    delay(30);
    dma_display->clearScreen();
    dma_display->setTextSize(4);
    dma_display->setCursor(i, 2);
    dma_display->setTextColor(dma_display->color565(148, 0, 211));
    dma_display->print("  -");
    dma_display->print(instaMessage);
    Credential_Reset();// Check whether to erase credentials or not
  }
  dma_display->clearScreen();
  dma_display->setTextSize(4);
  dma_display->setCursor(50, 2);
  dma_display->setTextColor(dma_display->color565(148, 0, 211));
  dma_display->print("  -");
  dma_display->print(instaMessage);

  for (int o = 0; o <= 5000; o++)
    drawInsta(50, 0);


  for (int i = 50; i > -300; i--) {
    drawInsta(i, 0);
    delay(30);
    dma_display->clearScreen();
    dma_display->setTextSize(4);
    dma_display->setCursor(i, 2);
    dma_display->setTextColor(dma_display->color565(148, 0, 211));
    dma_display->print("  -");
    dma_display->print(instaMessage);
    Credential_Reset();// Check whether to erase credentials or not
  }
}

//******************************************************************** Function For Displaying YouTube Subscribers and Logo
void youtube() {
  if (millis() > nextRunTime) {
    if (api.getChannelStatistics(CHANNEL_ID)) {
      Serial.println("---------Stats---------");
      Serial.print("Subscriber Count: ");
      Serial.println(api.channelStats.subscriberCount);
      Serial.print("View Count: ");
      Serial.println(api.channelStats.viewCount);
      Serial.print("Comment Count: ");
      Serial.println(api.channelStats.commentCount);
      Serial.print("Video Count: ");
      Serial.println(api.channelStats.videoCount);
      // Probably not needed :)
      Serial.print("hiddenSubscriberCount: ");
      Serial.println(api.channelStats.hiddenSubscriberCount);
      Serial.println("------------------------");
      Credential_Reset();
    }
    nextRunTime = millis() + timeBetweenRequests;
  }

  //************************** YOUTUBE *************************************
  for (int i = 300; i > 5; i--) {
    drawLoGo(i, 0);
    delay(40);
    dma_display->clearScreen();
    dma_display->setTextSize(4);
    dma_display->setCursor(i, 2);
    dma_display->setTextColor(myWHITE);
    dma_display->print("      -");
    dma_display->print(api.channelStats.subscriberCount);
    Credential_Reset();
  }

  dma_display->clearScreen();
  dma_display->setTextSize(4);
  dma_display->setCursor(5, 2);
  dma_display->setTextColor(myWHITE);
  dma_display->print("      -");
  dma_display->print(api.channelStats.subscriberCount);

  for (int o = 0; o <= 5000; o++)
    drawLoGo(5, 0);

  for (int i = 5; i > -320; i--) {
    drawLoGo(i, 0);
    delay(40);
    dma_display->clearScreen();
    dma_display->setTextSize(4);
    dma_display->setCursor(i, 2);
    dma_display->setTextColor(myWHITE);
    dma_display->print("      -");
    dma_display->print(api.channelStats.subscriberCount);
    Credential_Reset();
  }
}

//******************************************************************** Function For Displaying Custom Message on Board
void Inputtext() {

  int leng = customdata.length();
  Serial.println("Printing Data");
  Serial.println(leng);
  int len = leng * 25;
  Serial.println(len);
  for (int i = 300; i > -len; i--) {
    dma_display->setTextSize(4);
    dma_display->setCursor(i, 2);
    dma_display->setTextColor(dma_display->color565(r, g, b));
    dma_display->print(customdata);
    delay(30);
    dma_display->clearScreen();
    Credential_Reset();
  }
}


//******************************************************************** Function For Displaying Date, Time & Day

void Data()
{

  // Connect to HTTP server
  WiFiClient client;
  client.setTimeout(10000);
  if (!client.connect(Hostname, port)) {
    Serial.println(F("Connection failed"));
    return;
  }

  // Send HTTP request
  client.println("GET " + URI + " HTTP/1.0");
  client.println("Host: " + (String)Hostname);
  client.println("Connection: close");
  if (client.println() == 0) {
    Serial.println("Failed to send request");
    client.stop();
    return;
  }

  // Check HTTP status
  char status[32] = { 0 };
  client.readBytesUntil('\r', status, sizeof(status));
  if (strcmp(status, "HTTP/1.0 200 OK") != 0) {
    Serial.print(F("Unexpected response: "));
    Serial.println(status);
    client.stop();
    return;
  }

  // Skip HTTP headers
  char endOfHeaders[] = "\r\n\r\n";
  if (!client.find(endOfHeaders)) {
    Serial.println(F("Invalid response"));
    client.stop();
    return;
  }

  // Allocate the JSON document
  StaticJsonDocument<768> doc;

  // Parse JSON object
  DeserializationError error = deserializeJson(doc, client);
  if (error) {
    Serial.print(F("deserializeJson() failed: "));
    Serial.println(error.f_str());
    client.stop();
    return;
  }

  String datetime = doc["datetime"];  // 2022-02-11T15:21:21.732473+05:30

  int Day = doc["day_of_week"];

  Serial.println(datetime);
  Serial.println(Day);

  // Disconnect
  client.stop();
  /***************************************************************************
                FOR TIME
  ***************************************************************************/

  Time = datetime.substring(11, 16);
  Serial.print("mytime - ");
  Serial.println(Time);
  String Hour = datetime.substring(11, 13);

  // 24 hour to 12 hour conversion
  int h = Hour.toInt();
  if (h > 12)
    h = h - 12;
  else
    h = h;
  if (h > 12)
    ampm = 1;
  Serial.println(datetime);
  Hour = (String)h;
  Time = Time.substring(2);
  if (h >= 10)
    Time = Hour + Time;
  else
    Time = "0" + Hour + Time;

  Serial.print("time - ");
  Serial.println(Time);


  //********************** TIME **************************************

  for (int i = 300; i > 50; i--) {
    dma_display->setTextSize(4);
    dma_display->setCursor(i, 2);
    dma_display->setTextColor(myTECHIESMS);
    dma_display->print(Time);
    if (ampm = 1) {
      dma_display->print(" PM");
    } else {
      dma_display->print(" AM");
    }
    delay(5);
    dma_display->clearScreen();
    Credential_Reset();
  }

  dma_display->clearScreen();
  dma_display->setTextSize(4);
  dma_display->setCursor(50, 2);
  dma_display->setTextColor(myTECHIESMS);
  dma_display->print(Time);
  if (ampm = 1) {
    dma_display->print(" PM");
  } else {
    dma_display->print(" AM");
  }
  delay(5000);
  Credential_Reset();
  for (int i = 50; i > -200; i--) {
    dma_display->setTextSize(4);
    dma_display->setCursor(i, 2);
    dma_display->setTextColor(myTECHIESMS);
    dma_display->print(Time);
    if (ampm = 1) {
      dma_display->print(" PM");
    } else {
      dma_display->print(" AM");
    }
    delay(5);
    dma_display->clearScreen();
    Credential_Reset();
  }


  /***************************************************************************
              FOR DAY
   ***************************************************************************/

  String day = day_of_week;

  if (Day == 0)
    Day_str = "Sun";
  if (Day == 1)
    Day_str = "Mon";
  if (Day == 2)
    Day_str = "Tue";
  if (Day == 3)
    Day_str = "Wed";
  if (Day == 4)
    Day_str = "Thurs";
  if (Day == 5)
    Day_str = "Fri";
  if (Day == 6)
    Day_str = "Sat";


  Date = datetime.substring(4, 7);
  DATE = datetime.substring(8, 10);
  Serial.print("day - ");
  Serial.println(Day_str);
  Date = DATE + Date;
  Date = Date + " " + Day_str;
  Serial.print("date - ");
  Serial.println(Date);

  //************************ DATE ********************************************

  for (int i = 300; i > 50; i--) {
    dma_display->setTextSize(4);
    dma_display->setCursor(i, 2);
    dma_display->setTextColor(myTECHIESMS);
    dma_display->print(Date);
    delay(10);
    dma_display->clearScreen();
    Credential_Reset();
  }

  dma_display->clearScreen();
  dma_display->setTextSize(4);
  dma_display->setCursor(50, 2);
  dma_display->setTextColor(myTECHIESMS);
  dma_display->print(Date);
  delay(5000);
  Credential_Reset();


  for (int i = 50; i > -300; i--) {
    dma_display->setTextSize(4);
    dma_display->setCursor(i, 2);
    dma_display->setTextColor(myTECHIESMS);
    dma_display->print(Date);
    delay(10);
    dma_display->clearScreen();
    Credential_Reset();
  }
}

void loop() {

  //************************ If No Credentials are Provided ********************************************

  if (is_connected == 0) {
    //   DO NOTHING....
    dma_display->clearScreen();
    dma_display->setTextSize(4);
    dma_display->setCursor(0, 2);
    dma_display->setTextColor(myTECHIESMS);
    dma_display->print("Wifi ??");
    Credential_Reset() ;
  }
  //************************ After Successfully connecting to WiFi ********************************************

  if (is_connected == 1) {

    Data(); // Function to display Date, Time & Day

    if (instaconnect == 1)
      Instagram(); // Function to Display Instagram Followers

    youtube(); // Function to Display YouTube Subscribers

    if (inputvalue == 1)
      Inputtext(); // Function to Display Custom Message
  }
}

//******************************************************************** Function For Erasing Credentials and Resetting Board
void Credential_Reset() {
  if (digitalRead(0) == LOW) {
    Serial.println("Reset Button Pressed");
    delay(5000);
    if (digitalRead(0) == LOW) {
      wifi_prov_mgr_reset_provisioning();

      Serial.println("Resetting");
      ESP.restart();
    }
  }
}
